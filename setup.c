#include "setup.h"
#include <stdlib.h>

// --- ADC --- //

void SETUP_ADC(void){
 	SYSCTL_RCGCADC_R |= 1;
	SYSCTL_RCGCGPIO_R |= 1<<1;
	while ((SYSCTL_PRGPIO_R & (1<<1)) == 0);
	
	GPIO_PORTB_DEN_R &= ~(1<<5);
	GPIO_PORTB_AFSEL_R |= 1<<5;
	GPIO_PORTB_AMSEL_R |= 1<<5;
	
	ADC0_ACTSS_R &= ~ADC_ACTSS_ASEN3;
	ADC0_EMUX_R = (ADC0_EMUX_R &~ADC_EMUX_EM3_M) | ADC_EMUX_EM3_PROCESSOR;
	ADC0_SSMUX3_R = (ADC0_SSMUX3_R & ~0xF) | 11;

	ADC0_SSCTL3_R = (ADC0_SSCTL3_R & ~0xF) |ADC_SSCTL3_IE0 | ADC_SSCTL3_END0;  

  ADC0_ACTSS_R |= ADC_ACTSS_ASEN3;                                           
}

bool IS_CONVERSION_DONE(void){
	return (ADC0_RIS_R & ADC_RIS_INR3)!= 0; 
}

uint16_t GET_DATA(void){	
	ADC0_PSSI_R = ADC_PSSI_SS3;
	while (!IS_CONVERSION_DONE());
	ADC0_ISC_R = ADC_ISC_IN3;   
	return ADC0_SSFIFO3_R;
}

// --- PORTS --- //

void SETUP_PORTF(void) {
	SYSCTL_RCGCGPIO_R |= SYSCTL_RCGCGPIO_R5;
	while((SYSCTL_PRGPIO_R & SYSCTL_PRGPIO_R5)==0){}
	GPIO_PORTF_LOCK_R = 0x4C4F434B;
	GPIO_PORTF_AMSEL_R &= ~0X1F;
	GPIO_PORTF_AFSEL_R &= ~(0x11);

	GPIO_PORTF_DIR_R &= ~(0x11);
	GPIO_PORTF_PUR_R |= 0x11;
	GPIO_PORTF_DEN_R |= 0x11;

	GPIO_PORTF_DIR_R |= 0x0E;
	GPIO_PORTF_DR8R_R |= 0x0E;
	GPIO_PORTF_DEN_R |= 0x0E;

	GPIO_PORTF_DATA_R &=~(0x0E);
}

void SETUP_PORTD(void) {
	SYSCTL_RCGCGPIO_R |= SYSCTL_RCGCGPIO_R3;
	while( (SYSCTL_PRGPIO_R & SYSCTL_PRGPIO_R3)==0){}
	GPIO_PORTD_AMSEL_R &= ~0x0F;
	GPIO_PORTD_DIR_R &= ~0x0F;
	GPIO_PORTD_AFSEL_R &= ~0x0F;
	GPIO_PORTD_DEN_R |= 0x0F;
	GPIO_PORTD_PUR_R &= ~0x0F;
	GPIO_PORTD_PDR_R &= ~0x0F;
}

void TIMER_1MS(void){
	NVIC_ST_CTRL_R &= ~NVIC_ST_CTRL_ENABLE;
	NVIC_ST_RELOAD_R = (NVIC_ST_RELOAD_R&0xFF000000)|0x00003E7F;
	NVIC_ST_CURRENT_R &= ~(0x00FFFFFF);
	NVIC_ST_CTRL_R |= NVIC_ST_CTRL_CLK_SRC | NVIC_ST_CTRL_INTEN | NVIC_ST_CTRL_ENABLE;
}

// --- UART --- //

void SETUP_UART0(void){	  	
	uint32_t temp;
  SYSCTL_RCGC1_R |= SYSCTL_RCGC1_UART0;
  temp = SYSCTL_RCGC2_R;
  SYSCTL_RCGC2_R |= SYSCTL_RCGC2_GPIOA;
  // PA0 (U0Rx) PA1( U0Tx)  	
  temp = SYSCTL_RCGC2_R;
  UART0_CTL_R &= ~UART_CTL_UARTEN;
  UART0_IBRD_R = (UART0_IBRD_R & ~UART_IBRD_DIVINT_M)|104; 
  UART0_FBRD_R = (UART0_FBRD_R & ~UART_FBRD_DIVFRAC_M)|11;
  UART0_LCRH_R = ((UART0_LCRH_R & ~0x000000FF)|(UART_LCRH_WLEN_8)|(UART_LCRH_FEN));
  UART0_CTL_R |= UART_CTL_UARTEN;
  GPIO_PORTA_AMSEL_R &= ~(0x03);
  GPIO_PORTA_PCTL_R = (GPIO_PORTA_PCTL_R&0xFFFFFF00)|0x00000011;
  GPIO_PORTA_AFSEL_R |= 0x03;
  GPIO_PORTA_DEN_R |= 0x03;
	free(&temp);
}

uint8_t IS_THERE_A_CHAR(void){
	if ((UART0_FR_R & UART_FR_RXFE)!=0) return 0; 
	else return 1;
}

uint8_t CHAR_RX(void){ 
  uint8_t RX;
  RX = UART0_DR_R&0xFF;
  return RX;
}

void CHAR_TX(uint8_t CHARACTER){
  while((UART0_FR_R & UART_FR_TXFF)!=0);
  UART0_DR_R = CHARACTER;
}

void STRING_TX(uint8_t STRING[]){
  uint8_t i;
  for(i = 0; STRING[i]!='\0'; i++)
		CHAR_TX(STRING[i]);
}
